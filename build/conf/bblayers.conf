## build/conf/bblayers.conf
```bitbake
# POKY_BBLAYERS_CONF_VERSION is increased each time build/conf/bblayers.conf
# changes incompatibly
POKY_BBLAYERS_CONF_VERSION = "2"

BBPATH = "${TOPDIR}"
BBFILES ?= ""

BBLAYERS ?= " \
  /home/jinminu/projects/VmWatcher/poky/meta \
  /home/jinminu/projects/VmWatcher/poky/meta-poky \
  /home/jinminu/projects/VmWatcher/poky/meta-yocto-bsp \
  /home/jinminu/projects/VmWatcher/meta-raspberrypi \
  /home/jinminu/projects/VmWatcher/meta-openembedded/meta-oe \
  /home/jinminu/projects/VmWatcher/meta-openembedded/meta-networking \
  /home/jinminu/projects/VmWatcher/meta-openembedded/meta-python \
  /home/jinminu/projects/VmWatcher/meta-openembedded/meta-multimedia \
  /home/jinminu/projects/VmWatcher/build/workspace \
  "
```
